## config/west.yml
```yaml
manifest:
  remotes:
    - name: zmkfirmware
      url-base: https://github.com/zmkfirmware
    - name: ambrosia
      url-base: https://github.com/ambrosia
  projects:
    - name: zmk
      remote: zmkfirmware
      revision: v0.3.0
      import: app/west.yml
    - name: zmk-behavior-magic-keys
      remote: ambrosia
      revision: single-instance
      path: whereever-you-want
  self:
    path: config
```
